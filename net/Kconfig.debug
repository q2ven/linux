## net/Kconfig.debug
```kconfig
# SPDX-License-Identifier: GPL-2.0-only

config NET_DEV_REFCNT_TRACKER
	bool "Enable net device refcount tracking"
	depends on DEBUG_KERNEL && STACKTRACE_SUPPORT && NET
	select REF_TRACKER
	default n
	help
	  Enable debugging feature to track device references.
	  This adds memory and cpu costs.

config NET_NS_REFCNT_TRACKER
	bool "Enable networking namespace refcount tracking"
	depends on DEBUG_KERNEL && STACKTRACE_SUPPORT && NET
	select REF_TRACKER
	default n
	help
	  Enable debugging feature to track netns references.
	  This adds memory and cpu costs.

config DEBUG_NET
	bool "Add generic networking debug"
	depends on DEBUG_KERNEL && NET
	help
	  Enable extra sanity checks in networking.
	  This is mostly used by fuzzers, but is safe to select.

config NET_SPLIT_RTNL_LOCK
	bool "Add extra per-netns RTNL locking"
	depends on DEBUG_KERNEL && LOCKDEP && NET
	help
	  Add extra per-netns RTNL locking inside the rtnl_lock()
	  critical section for future removal of the big lock.

	  Once all rtnl_lock() instances were replaced with
	  rtnl_net_lock(net) or rtnl_across_net_lock(net1, net2),
	  rtnl_lock() would be removed completely.
```

## net/bgp/Kconfig
```kconfig
# SPDX-License-Identifier: GPL-2.0-only
#
# BGP configuration
#

config BGP
	tristate "Border Gateway Protocol"
	depends on INET
	default n
	help
	Enable kernel support for BGP protocol.

	If unsure, say N.
```
